## west.yml
```yaml
# Copyright (c) 2026 HubbleNetwork
# SPDX-License-Identifier: Apache-2.0

manifest:

  self:
    west-commands: scripts/west-commands.yml

  remotes:
    - name: HubbleNetwork
      url-base: https://github.com/HubbleNetwork
    - name: zephyrproject
      url-base: https://github.com/zephyrproject-rtos

  projects:
    - name: zephyr
      remote: zephyrproject
      revision: v4.4.0
      import:
        name-allowlist:
          - cmsis_6
          - hal_nordic
          - libmetal
          - mbedtls
          - open-amp
          - tf-psa-crypto
    - name: hubble-device-sdk
      remote: HubbleNetwork
      path: modules/lib/hubblenetwork-sdk
      revision: 9af0cc2032ddb2c4749127ad09681480beb68e7c
```
